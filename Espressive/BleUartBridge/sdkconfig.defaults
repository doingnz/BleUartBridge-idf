## Espressive/BleUartBridge/sdkconfig.defaults
```kconfig
# ── Bluetooth / NimBLE ───────────────────────────────────────────────────────
CONFIG_BT_ENABLED=y
CONFIG_BT_NIMBLE_ENABLED=y
# Disable Bluedroid — NimBLE is used exclusively
CONFIG_BT_BLUEDROID_ENABLED=n

# Single peripheral connection is sufficient
CONFIG_BT_NIMBLE_MAX_CONNECTIONS=1

# Increase msys mbuf pool — default 12 blocks is insufficient for full-speed
# bidirectional traffic (both RX writes and TX notifications consume mbufs
# simultaneously).  24 blocks provides headroom for sustained dual-direction use.
CONFIG_BT_NIMBLE_MSYS_1_BLOCK_COUNT=24

# Peripheral role only (saves memory vs enabling all roles)
CONFIG_BT_NIMBLE_ROLE_PERIPHERAL=y
CONFIG_BT_NIMBLE_ROLE_CENTRAL=n
CONFIG_BT_NIMBLE_ROLE_OBSERVER=n
CONFIG_BT_NIMBLE_ROLE_BROADCASTER=n

# Preferred ATT MTU — client will negotiate down if it can't match
CONFIG_BT_NIMBLE_ATT_PREFERRED_MTU=512

# NimBLE host task stack (4 KB is comfortable for this workload)
CONFIG_BT_NIMBLE_HOST_TASK_STACK_SIZE=4096

# Store NimBLE RAM in internal SRAM for reliability
CONFIG_BT_NIMBLE_MEM_ALLOC_MODE_INTERNAL=y

# ── UART ─────────────────────────────────────────────────────────────────────
# Keep UART ISR in IRAM so it is not evicted during flash operations
CONFIG_UART_ISR_IN_IRAM=y

# ── Logging ───────────────────────────────────────────────────────────────────
CONFIG_LOG_DEFAULT_LEVEL_INFO=y

# ── OTA / Rollback ───────────────────────────────────────────────────────────
# A freshly-booted image MUST call esp_ota_mark_app_valid_cancel_rollback()
# before the next reset, otherwise the bootloader reverts to the previous slot.
# Anti-rollback is deliberately NOT enabled — downgrades are allowed (user
# decision: reflash of older versions permitted).
CONFIG_BOOTLOADER_APP_ROLLBACK_ENABLE=y

# ── mbedTLS — curve primitives for DFU signature verify ──────────────────────
# ECP + P-256 curve; used by main/verify_ecdsa.c to check ECDSA firmware
# signatures before applying an OTA update.  The public mbedtls/ecdsa.h was
# moved to the private tree in mbedTLS 4.x, but the low-level ECP+MPI ops
# remain accessible via IDF's port shim, which is what verify_ecdsa.c uses.
CONFIG_MBEDTLS_ECP_C=y
CONFIG_MBEDTLS_ECP_DP_SECP256R1_ENABLED=y
```

## Espressive/BleUartBridge/sdkconfig.defaults.esp32
```kconfig
# ── Target ───────────────────────────────────────────────────────────────────
CONFIG_IDF_TARGET="esp32"

# ── Flash ─────────────────────────────────────────────────────────────────────
CONFIG_ESPTOOLPY_FLASHSIZE_8MB=y
CONFIG_ESPTOOLPY_FLASHSIZE="8MB"

# ── Console ───────────────────────────────────────────────────────────────────
# Classic ESP32 has no native USB — console via UART0 (CH340/CP2102 USB-UART chip)
#
# In IDF v6.0 (esp_stdio component), CONFIG_ESP_CONSOLE_UART_BAUDRATE has the
# prompt "if ESP_CONSOLE_UART_CUSTOM" — the baud rate is only user-configurable
# when CUSTOM is selected; with DEFAULT selected it is locked to 115200 and
# sdkconfig.defaults overrides are silently ignored.  Using CUSTOM with NUM=0
# keeps console on UART0 while allowing the baud rate to be changed.
#
# 460800 baud keeps hex dump output ahead of BLE write traffic (128 B chunk
# becomes ~480 chars of output; at 115200 that is ~42 ms per write but BLE
# writes arrive every ~20 ms, saturating the FIFO and causing uart_tx_char to
# busy-wait indefinitely, which starves the task watchdog).  921600 is within
# the CH340G spec but the baud-rate divisor error (~3%) sits at the UART
# tolerance limit and causes silent fallback to 115200 on some boards/drivers;
# 460800 has <1% error and is reliable on all CH340 variants.
CONFIG_ESP_CONSOLE_UART_CUSTOM=y
CONFIG_ESP_CONSOLE_UART_NUM=0
CONFIG_ESP_CONSOLE_UART_BAUDRATE=460800

# ── Partition table ──────────────────────────────────────────────────────────
# Two maximal OTA slots (~3.87 MB each) with room for nvs, otadata, phy_init.
CONFIG_PARTITION_TABLE_CUSTOM=y
CONFIG_PARTITION_TABLE_CUSTOM_FILENAME="partitions_esp32.csv"
```

## Espressive/BleUartBridge/sdkconfig.defaults.esp32s3
```kconfig
# ── Target ───────────────────────────────────────────────────────────────────
CONFIG_IDF_TARGET="esp32s3"

# ── Flash ─────────────────────────────────────────────────────────────────────
# S3-N16R8: 16 MB flash, 8 MB PSRAM
CONFIG_ESPTOOLPY_FLASHSIZE_16MB=y
CONFIG_ESPTOOLPY_FLASHSIZE="16MB"

# ── Console ───────────────────────────────────────────────────────────────────
# ESP32-S3 DevKit uses built-in USB Serial/JTAG controller (no external chip)
# getchar() reads from USB CDC; GPIO1/3 are unused as console.
CONFIG_ESP_CONSOLE_USB_SERIAL_JTAG=y

# ── Partition table ──────────────────────────────────────────────────────────
# Two maximal OTA slots (~7.87 MB each) with room for nvs, otadata, phy_init.
CONFIG_PARTITION_TABLE_CUSTOM=y
CONFIG_PARTITION_TABLE_CUSTOM_FILENAME="partitions_esp32s3.csv"
```
